## conf/layer.conf
```bitbake
# We have a conf and classes directory, add to BBPATH
BBPATH .= ":${LAYERDIR}"

# We have recipes-* directories, add to BBFILES
BBFILES += "${LAYERDIR}/recipes-*/*/*.bb \
            ${LAYERDIR}/recipes-*/*/*.bbappend"

BBFILE_COLLECTIONS += "meta-cfengine"
BBFILE_PATTERN_meta-cfengine = "^${LAYERDIR}/"
BBFILE_PRIORITY_meta-cfengine = "6"

LAYERDEPENDS_meta-cfengine = "core"
LAYERSERIES_COMPAT_meta-cfengine = "warrior"
```
